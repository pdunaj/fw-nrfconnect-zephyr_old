## prj.conf
```kconfig
CONFIG_SYSTEM_WORKQUEUE_STACK_SIZE=4096
CONFIG_HEAP_MEM_POOL_SIZE=4096

CONFIG_SYS_CLOCK_TICKS_PER_SEC=1000

CONFIG_NUM_COOP_PRIORITIES=20
CONFIG_NUM_PREEMPT_PRIORITIES=20

CONFIG_TIMESLICE_SIZE=100

CONFIG_SPEED_OPTIMIZATIONS=y

CONFIG_ASSERT=y
CONFIG_ASSERT_LEVEL=2

CONFIG_SYS_POWER_MANAGEMENT=n

CONFIG_LOG=y
CONFIG_LOG_DEFAULT_LEVEL=2
#CONFIG_LOG_MODE_NO_OVERFLOW=y
CONFIG_LOG_PRINTK=y
CONFIG_LOG_IMMEDIATE=y
#CONFIG_LOG_PRINTK_MAX_STRING_LENGTH=256
#CONFIG_LOG_BUFFER_SIZE=4096
#CONFIG_LOG_STRDUP_BUF_COUNT=64
#CONFIG_LOG_STRDUP_MAX_STRING=64
#CONFIG_LOG_PROCESS_THREAD_STACK_SIZE=1024

CONFIG_LOG_BACKEND_RTT=y
CONFIG_LOG_BACKEND_RTT_MODE_DROP=y
# CONFIG_LOG_BACKEND_RTT_MODE_BLOCK is not set
CONFIG_LOG_BACKEND_RTT_MESSAGE_SIZE=128
CONFIG_LOG_BACKEND_RTT_BUFFER=0
CONFIG_LOG_BACKEND_SHOW_COLOR=y
CONFIG_LOG_BACKEND_FORMAT_TIMESTAMP=y

CONFIG_CONSOLE=y
CONFIG_USE_SEGGER_RTT=y
CONFIG_SEGGER_RTT_BUFFER_SIZE_UP=4096
CONFIG_RTT_CONSOLE=y
CONFIG_UART_CONSOLE=n
```

## src/main.c
```c
#include <zephyr.h>
#include <misc/util.h>
#include <logging/log.h>

LOG_MODULE_REGISTER(sched_demo, 4);

#define THREAD_COUNT 2
#define STACK_SIZE 1024

static K_THREAD_STACK_ARRAY_DEFINE(stack, THREAD_COUNT, STACK_SIZE);
static struct k_thread thread[THREAD_COUNT];


static void thread_fn(void *p1, void *p2, void *p3)
{
	size_t id = (size_t)p1;

	while (true) {
		LOG_INF("%zu: %p", id, k_current_get());
		k_busy_wait(100000);
	}
}

void main(void)
{
	for (size_t i = 0; i < ARRAY_SIZE(thread); i++) {
		k_thread_create(&thread[i],
				stack[i], STACK_SIZE,
				(k_thread_entry_t)thread_fn,
				(void *)i, NULL, NULL,
				K_PRIO_PREEMPT(0), 0, K_NO_WAIT);
		LOG_INF("Thread %zu created", i);
	}
	LOG_INF("Start");
}
```
